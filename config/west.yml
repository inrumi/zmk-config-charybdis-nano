## config/west.yml
```yaml
manifest:
  remotes:
    - name: zmkfirmware
      url-base: https://github.com/zmkfirmware
    - name: badjeff
      url-base: https://github.com/badjeff
    - name: inrumi
      url-base: https://github.com/inrumi
    - name: urob
      url-base: https://github.com/urob
  projects:
    - name: zmk
      remote: zmkfirmware
      revision: v0.3
      import: app/west.yml

    - name: zmk-tri-state
      remote: urob
      revision: main
    - name: zmk-auto-layer
      remote: urob
      revision: main
    - name: zmk-helpers
      remote: urob
      revision: main

    - name: zmk-pmw3610-driver
      remote: badjeff
      revision: main
    - name: zmk-dongle-display
      remote: inrumi
      revision: main
  self:
    path: config
```
